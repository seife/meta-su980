## conf/layer.conf
```bitbake
# We have a conf and classes directory, add to BBPATH
BBPATH .= ":${LAYERDIR}"

# We have a recipes-* directories, add to BBFILES
BBFILES += "${LAYERDIR}/recipes-*/*/*.bb \
	${LAYERDIR}/recipes-*/*/*.bbappend"

BBFILE_COLLECTIONS += "su980"
BBFILE_PATTERN_su980 = "^${LAYERDIR}/"
BBFILE_PRIORITY_su980 = "6"
```

## conf/machine/include/tune-su980.inc
```bitbake
#TARGET_ARCH = "arm"
#TARGET_FPU = "soft"
DEFAULTTUNE = "cortexa9"

require conf/machine/include/tune-cortexa9.inc

#TUNEVALID[cortexa9] = "Enable Cortex-A9 specific processor optimizations"
#
# not sure if we need this everywhere or just to compile the kernel...
TUNE_CCARGS += "${@bb.utils.contains("TUNE_FEATURES", "cortexa9", "-march=armv7-a -mtune=cortex-a9 -mfpu=vfpv3-d16 -mfloat-abi=softfp", "", d)}"
```

## conf/machine/su980.conf
```bitbake
#@TYPE: Machine
#@NAME: Golden Media HyperCube
#@DESCRIPTION: Machine configuration for the su980

MACHINE_ESSENTIAL_EXTRA_RDEPENDS += "\
	${MACHINE}-dvb-modules \
	${MACHINE}-shutdown \
"

EXTRA_IMAGEDEPENDS += "\
	${MACHINE}-ca-test \
	${MACHINE}-play-test \
	${MACHINE}-uboot-tools \
	${MACHINE}-user-libs \
	${MACHINE}-extra-modules \
	"

MACHINE_EXTRA_RDEPENDS = "\
	${MACHINE}-ca-test \
	${MACHINE}-play-test \
	${MACHINE}-uboot-tools \
	${MACHINE}-user-libs \
	"

module_autoload_nls-iso8859-1 = "nls-iso8859-1"
module_autoload_nls-iso8859-15 = "nls-iso8859-15"
module_autoload_nls-cp437 = "nls-cp437"
module_autoload_nls-cp850 = "nls-cp850"
module_autoload_exportfs = "exportfs"
module_autoload_xfs = "xfs"
module_autoload_iso9660 = "iso9660"
module_autoload_udf = "udf"
module_autoload_cdfs = "cdfs"
module_autoload_ntfs = "ntfs"

DVBMEDIASINK_CONFIG = "--with-dts --with-limited-mpeg4v2 --with-eac3 --with-wma --with-wmv --with-pcm"

IMAGE_FSTYPES ?= "jffs2 ext3 su980-usbimg tar.bz2"

IMAGE_CLASSES += "usb_image-su980"

JFFS2_ERASEBLOCK = "0x20000"
EXTRA_IMAGECMD_jffs2 = "--disable-compressor=lzo --compression-mode=size"

UPDATE_DIR ?= "e2"

# TODO: this needs fixing...
IMAGE_CMD_jffs2_append = "; \
	cd ${DEPLOY_DIR_IMAGE}; \
	rm -r ${MACHINE}; \
	mkdir ${MACHINE} ${MACHINE}/${UPDATE_DIR}; \
	cp -a boot.bin loader.bin upgrade.scr ${MACHINE}/; \
	cp -L ${KERNEL_IMAGETYPE}-${MACHINE}.bin ${MACHINE}/${UPDATE_DIR}/e2-kernel.bin; \
	cp -a ${IMAGE_NAME}.rootfs.jffs2 ${MACHINE}/${UPDATE_DIR}/e2-rootfs.jffs2; \
        zip -r ${IMAGE_NAME}_usb.zip ${MACHINE}/*; \
        "

MACHINE_FEATURES += "alsa 32bpp hdtv usbhost wifi 3dtv ci wifiusblegacy legacykernel"

require conf/machine/include/tune-su980.inc
include conf/machine/include/autoload-usbserial.inc

KERNEL_IMAGETYPE ?= "Image"

SERIAL_CONSOLE = "115200 ttyS1"

PREFERRED_PROVIDER_virtual/kernel ?= "linux-${MACHINE}"
# PREFERRED_VERSION_linux-libc-headers = "2.6.34"
# PREFERRED_VERSION_wpa-supplicant = "0.5.8"
# PREFERRED_VERSION_rtl8192cu = "3.3.0"
# PREFERRED_VERSION_usbmodeswitch = "1.2.7"

# MACHINE_KERNEL_PR = "${GMVERSION}.${GMREVISION}"
```
